## apps/zircon-server/Kconfig
```kconfig
#
# Copyright 2017, Data61
# Commonwealth Scientific and Industrial Research Organisation (CSIRO)
# ABN 41 687 119 230.
#
# This software may be distributed and modified according to the terms of
# the BSD 2-Clause license. Note that NO WARRANTY is provided.
# See "LICENSE_BSD2.txt" for details.
#
# @TAG(DATA61_BSD)
#

menuconfig APP_ZIRCON_SERVER
    bool "seL4 Zircon server"
    default y
    depends on LIB_SEL4 && (LIB_MUSL_C || LIB_SEL4_C) && LIB_SEL4_PLAT_SUPPORT && LIB_SEL4_VKA && LIB_SEL4_TEST && LIB_SEL4_UTILS && LIB_UTILS && LIB_SEL4_DEBUG
    help
        User-level server for handling Zircon syscalls.
```

## apps/zircon-test/Kconfig
```kconfig
#
# Copyright 2017, Data61
# Commonwealth Scientific and Industrial Research Organisation (CSIRO)
# ABN 41 687 119 230.
#
# This software may be distributed and modified according to the terms of
# the BSD 2-Clause license. Note that NO WARRANTY is provided.
# See "LICENSE_BSD2.txt" for details.
#
# @TAG(DATA61_BSD)
#

menuconfig APP_ZIRCON_TEST
    bool "Tester for zircon syscalls"
    default y
    depends on LIB_SEL4 && (LIB_MUSL_C || LIB_SEL4_C) && LIB_SEL4_MUSLC_SYS && LIB_UTILS
    help
        Tests for zircon syscalls.
```

## libzircon/Kconfig
```kconfig
menuconfig LIB_ZIRCON
    bool "libzircon"
    depends on HAVE_LIB_SEL4 && HAVE_LIB_UTILS && HAVE_LIBC
    select HAVE_LIB_ZIRCON
    select HAVE_SEL4ZIRCON
    default y
    help
        Support for using zircon syscalls.

config HAVE_LIB_ZIRCON
    bool

config HAVE_SEL4ZIRCON
    bool
```

## libzxutils/Kconfig
```kconfig
menuconfig LIB_ZXUTILS
    bool "libzxutils"
    depends on HAVE_LIB_ZIRCON && HAVE_LIBC
    select HAVE_LIB_ZXUTILS
    default y
    help
        Various zircon userspace libraries.

config HAVE_LIB_ZXUTILS
    bool
```
